## main/Kconfig.projbuild
```kconfig
menu "XPowersLib Configuration"

    choice PMU_Type
        prompt "XPowers chip type"
        default XPOWERS_CHIP_AXP202 if IDF_TARGET_ESP32S3
        default XPOWERS_CHIP_AXP202 if IDF_TARGET_ESP32C6
        default XPOWERS_CHIP_AXP2101
        help
            Defines the default peripheral for xpowers example

        config XPOWERS_CHIP_AXP2101
            bool "Xpowers AXP2101"
        config XPOWERS_CHIP_AXP202
            bool "Xpowers AXP202"
        config XPOWERS_CHIP_AXP192
            bool "Xpowers AXP192"
    endchoice

    choice XPowersLib_ESP_IDF_API
        prompt "XPowers library esp-idf api version"
        default XPOWERS_ESP_IDF_NEW_API
        help
            Define API version

        config XPOWERS_ESP_IDF_NEW_API
            bool "Use esp-idf higher version (>= 5.0) API"
        config XPOWERS_ESP_IDF_OLD_API
            bool "Use esp-idf lower version (< 5.0) API, Compatible with lower versions of esp-idf"
    endchoice

    choice I2C_COMMUNICATION_METHOD
        prompt "XPowersLIb read and write methods"
        default I2C_COMMUNICATION_METHOD_BUILTIN_RW
        help
            Define XPowersLIb read and write methods

        config I2C_COMMUNICATION_METHOD_BUILTIN_RW
            bool "Implemented using built-in read and write methods"
        config I2C_COMMUNICATION_METHOD_CALLBACK_RW
            bool "Implemented using read and write callback methods"
    endchoice

    config I2C_MASTER_PORT_NUM
        int "PMU I2C Port Number"
        default 0 if IDF_TARGET_ESP32S3
        default 0 if IDF_TARGET_ESP32C6
        default 1
        help
            Port number for I2C Master device.

    config I2C_MASTER_FREQUENCY
        int "Master Frequency"
        default 400000 if IDF_TARGET_ESP32S3
        default 400000 if IDF_TARGET_ESP32C6
        default 100000
        help
            I2C Speed of Master device.

    config PMU_I2C_SCL
        int "PMU SCL GPIO Num"
        default 48 if IDF_TARGET_ESP32S3
        default 10 if IDF_TARGET_ESP32C6
        default -1
        help
            GPIO number for I2C PMU clock line.

    config PMU_I2C_SDA
        int "PMU SDA GPIO Num"
        default 47 if IDF_TARGET_ESP32S3
        default 11 if IDF_TARGET_ESP32C6
        default -1
        help
            GPIO number for I2C PMU data line.

    config PMU_INTERRUPT_PIN
        int "PMU Interrupt Pin"
        default 2 if IDF_TARGET_ESP32S3
        default 5 if IDF_TARGET_ESP32C6
        default -1
        help
            PMU interrupt pin.

endmenu

menu "SensorLib Example Configuration"

    choice SensorLib_ESP_IDF_API
        prompt "SensorLib library esp-idf api version"
        default SENSORLIB_ESP_IDF_NEW_API
        help
            Define API version

        config SENSORLIB_ESP_IDF_NEW_API
            bool "Use esp-idf higher version (>= 5.0) API"
        config SENSORLIB_ESP_IDF_OLD_API
            bool "Use esp-idf lower version (< 5.0) API, Compatible with lower versions of esp-idf"
    endchoice

    choice SENSOR_TYPE
        prompt "Select Sensor Type"
        default PCF8563
        help
            Choose the type of sensor you are using.

        config PCF8563
            bool "PCF8563 Sensor"
        config BMA423
            bool "BMA423 Sensor"
        config BHI260
            bool "BHI260 Sensor"
        config FT636X
            bool "FT636X Capacitive touch"
        config XL9555
            bool "XL9555 GPIO expansion"
    endchoice

    choice BHI260_COMMUNICATION_TYPE
        prompt "Select BHI260 Communication Type"
        default USE_I2C_INTERFACE
        depends on BHI260
        help
            Choose the communication type for BHI260 sensor.

        config USE_I2C_INTERFACE
            bool "I2C Communication"
        config USE_SPI_INTERFACE
            bool "SPI Communication"
    endchoice

    choice I2C_COMMUNICATION_METHOD
        prompt "SensorLib read and write methods"
        default I2C_COMMUNICATION_METHOD_BUILTIN_RW
        depends on (PCF8563 || BMA423 || FT636X || XL9555 || (BHI260 && USE_I2C_INTERFACE))
        help
            Define SensorLib read and write methods

        config I2C_COMMUNICATION_METHOD_BUILTIN_RW
            bool "Implemented using built-in read and write methods"
        config I2C_COMMUNICATION_METHOD_CALLBACK_RW
            bool "Implemented using read and write callback methods"
    endchoice

    config I2C_MASTER_PORT_NUM
        int "Sensor I2C Port Number"
        default 0 if IDF_TARGET_ESP32S3
        default 0 if IDF_TARGET_ESP32C6
        default 1
        depends on (PCF8563 || BMA423 || FT636X || XL9555 ||  (BHI260 && USE_I2C_INTERFACE))
        help
            Port number for I2C Master device.

    config I2C_MASTER_FREQUENCY
        int "Master Frequency"
        default 400000 if IDF_TARGET_ESP32S3
        default 400000 if IDF_TARGET_ESP32C6
        default 100000
        depends on (PCF8563 || BMA423 || FT636X || XL9555 ||  (BHI260 && USE_I2C_INTERFACE))
        help
            I2C Speed of Master device.

    config SENSOR_SCL
        int "Sensor SCL GPIO Num"
        default 48 if IDF_TARGET_ESP32S3
        default 10 if IDF_TARGET_ESP32C6
        default -1
        depends on (PCF8563 || BMA423 || FT636X || XL9555 ||  (BHI260 && USE_I2C_INTERFACE))
        help
            GPIO number for I2C clock line.

    config SENSOR_SDA
        int "Sensor SDA GPIO Num"
        default 47 if IDF_TARGET_ESP32S3
        default 11 if IDF_TARGET_ESP32C6
        default -1
        depends on (PCF8563 || BMA423 || FT636X || XL9555 ||   (BHI260 && USE_I2C_INTERFACE))
        help
            GPIO number for I2C data line.

    config SPI_MISO
        int "SPI MISO GPIO Num"
        default -1
        depends on (BHI260 && USE_SPI_INTERFACE)
        help
            GPIO number for Sensor SPI MISO line.

    config SPI_MOSI
        int "SPI MOSI GPIO Num"
        default -1
        depends on (BHI260 && USE_SPI_INTERFACE)
        help
            GPIO number for Sensor SPI MOSI line.

    config SPI_SCK
        int "SPI SCK GPIO Num"
        default -1
        depends on (BHI260 && USE_SPI_INTERFACE)
        help
            GPIO number for Sensor SPI SCK line.

    config SPI_CS
        int "SPI CS GPIO Num"
        default -1
        depends on (BHI260 && USE_SPI_INTERFACE)
        help
            GPIO number for Sensor SPI CS line.

    config SENSOR_IRQ
        int "Sensor Interrupt Pin"        
        default -1
        help
            GPIO number for Sensor Interrupt line.

    config SENSOR_RST
        int "Sensor reset Pin"
        default -1
        help
            GPIO number for Sensor Reset line.

endmenu

menu "HP28008 LVGL Configuration"

    config HP28008_USE_I2C_MASTER_BUS
        bool
        default y if SENSORLIB_ESP_IDF_NEW_API || XPOWERS_ESP_IDF_NEW_API
        default n
        help
            GT911 touch uses esp-idf I2C master API (esp_lcd i2c v2) when enabled.
            Automatically derived from SensorLib/XPowersLib I2C API choice.

endmenu

menu "SD SPI Example Configuration"

    config EXAMPLE_FORMAT_IF_MOUNT_FAILED
        bool "Format the card if mount failed"
        default n
        help
            If this config item is set, format_if_mount_failed will be set to true and the card will be formatted if
            the mount has failed.

    config EXAMPLE_FORMAT_SD_CARD
        bool "Format the card as a part of the example"
        default n
        help
            If this config item is set, the card will be formatted as a part of the example.

    config EXAMPLE_PIN_MOSI
        int "MOSI GPIO number"
        default 11 if IDF_TARGET_ESP32S3

    config EXAMPLE_PIN_MISO
        int "MISO GPIO number"
        default 13 if IDF_TARGET_ESP32S3

    config EXAMPLE_PIN_CLK
        int "CLK GPIO number"
        default 12 if IDF_TARGET_ESP32S3

    config EXAMPLE_PIN_CS
        int "CS GPIO number"
        default 14 if IDF_TARGET_ESP32S3

    config EXAMPLE_DEBUG_PIN_CONNECTIONS
        bool "Debug sd pin connections and pullup strength"
        default y if IDF_TARGET_ESP32S3
        default n

    config EXAMPLE_ENABLE_ADC_FEATURE
        bool "Enable ADC feature"
        depends on EXAMPLE_DEBUG_PIN_CONNECTIONS
        default y if IDF_TARGET_ESP32
        default n

    config EXAMPLE_ADC_UNIT
        int "ADC Unit"
        depends on EXAMPLE_DEBUG_PIN_CONNECTIONS
        default 1 if IDF_TARGET_ESP32
        default 0 if IDF_TARGET_ESP32S3
        default 1

    config EXAMPLE_ADC_PIN_MOSI
        int "MOSI mapped ADC pin"
        depends on EXAMPLE_ENABLE_ADC_FEATURE
        default 3 if IDF_TARGET_ESP32
        default 7 if IDF_TARGET_ESP32S3
        default 1

    config EXAMPLE_ADC_PIN_MISO
        int "MISO mapped ADC pin"
        depends on EXAMPLE_ENABLE_ADC_FEATURE
        default 2 if IDF_TARGET_ESP32
        default 1 if IDF_TARGET_ESP32S3
        default 1

    config EXAMPLE_ADC_PIN_CLK
        int "CLK mapped ADC pin"
        depends on EXAMPLE_ENABLE_ADC_FEATURE
        default 6 if IDF_TARGET_ESP32
        default 0 if IDF_TARGET_ESP32S3
        default 1

    config EXAMPLE_ADC_PIN_CS
        int "CS mapped ADC pin"
        depends on EXAMPLE_ENABLE_ADC_FEATURE
        default 4 if IDF_TARGET_ESP32
        default 6 if IDF_TARGET_ESP32S3
        default 1

    config EXAMPLE_SD_PWR_CTRL_LDO_INTERNAL_IO
        depends on SOC_SDMMC_IO_POWER_EXTERNAL
        bool "SD power supply comes from internal LDO IO (READ HELP!)"
        default n
        help
            Only needed when the SD card is connected to specific IO pins which can be used for high-speed SDMMC.
            Please read the schematic first and check if the SD VDD is connected to any internal LDO output.
            Unselect this option if the SD card is powered by an external power supply.

    config EXAMPLE_SD_PWR_CTRL_LDO_IO_ID
        depends on SOC_SDMMC_IO_POWER_EXTERNAL && EXAMPLE_SD_PWR_CTRL_LDO_INTERNAL_IO
        int "LDO ID"
        default 4 if IDF_TARGET_ESP32P4
        help
            Please read the schematic first and input your LDO ID.
endmenu

menu "LVGL QEMU RGB Example Configuration"

    config LVGL_QEMU_RGB_DEDIC_FB
        bool "Use QEMU RGB panel dedicated framebuffer as LVGL draw buffer"
        default n
        help
            启用后直接用 QEMU 虚拟面板自带帧缓冲（物理地址 0x20000000，整屏 800x480）作为 LVGL draw buffer，配合 FULL 渲染模式实现零拷贝；关闭（默认）则从内部 RAM 分配 10 行小 draw buffer，走 PARTIAL 分块渲染。

endmenu
```
