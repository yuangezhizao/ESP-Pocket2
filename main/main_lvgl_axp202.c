/*
 * AXP202 电源状态仪表盘（LVGL）——支持两种显示后端，共用同一套页面：
 *
 *   1) 真机：ST7789 SPI LCD（见 main/lvgl/hp28008.c），通过 I2C 读取 AXP202/BM8563
 *      的真实数据。用于烧录到实际硬件。
 *      (CONFIG_AXP202_UI_PANEL_ST7789)
 *
 *   2) QEMU：espressif/esp_lcd_qemu_rgb 虚拟帧缓冲面板，直接渲染到 QEMU 窗口
 *      （idf.py qemu --graphics）。QEMU 无真实 PMU/LCD，数据为模拟值。
 *      (CONFIG_AXP202_UI_PANEL_QEMU_RGB)
 *
 * 两种后端仅在“显示驱动”和“数据来源”上不同，UI 部分（axp202_ui_create）完全一致。
 * 通过 menuconfig：AXP202 Dashboard UI → Display panel 选择。
 *
 * SPDX-License-Identifier: Apache-2.0
 */

#include <stdio.h>
#include <string.h>

#include "freertos/FreeRTOS.h"
#include "freertos/task.h"

#include "esp_log.h"
#include "esp_err.h"

#include "lvgl.h"

#include "sdkconfig.h"

/* 电源轨枚举与读写 API：两种后端共用类型（QEMU 仅用类型，不调用写操作）*/
#include "axp202_port.h"

#if CONFIG_AXP202_UI_PANEL_QEMU_RGB
/* ---- QEMU 虚拟 RGB 面板后端 ---- */
#include "freertos/semphr.h"
#include "esp_timer.h"
#include "esp_lcd_panel_ops.h"
#include "esp_lcd_qemu_rgb.h"
#else
/* ---- ST7789 真机后端 ---- */
#include "esp_idf_version.h"
#include "esp_lvgl_port.h"
#include "hp28008.h"
#include "i2c_driver.h"
#include "i2c_port.h"
#include "sensor_bm8563.h"
#include "i2c_app.h"
#endif

static const char *TAG = "AXP202-UI";

/* Chinese subset font (Droid Sans Fallback), generated by lv_font_conv.
 * Covers the few Han characters used in card titles + ASCII. */
LV_FONT_DECLARE(font_zh_16);

/* ---- Display geometry (landscape) ---- */
#define LCD_H_RES               320
#define LCD_V_RES               240

#if CONFIG_AXP202_UI_PANEL_QEMU_RGB
/* ---- LVGL task / tick (QEMU 后端自行驱动 LVGL) ---- */
#define LVGL_BUF_LINES          40
#define LVGL_TICK_PERIOD_MS     2
#define LVGL_TASK_STACK         (8 * 1024)
#define LVGL_TASK_PRIORITY      4
#define LVGL_TASK_MAX_DELAY_MS  500
#define LVGL_TASK_MIN_DELAY_MS  1
#endif

/* ---- Color palette (dark dashboard) ---- */
#define COL_BG       lv_color_hex(0x0B1020)
#define COL_BG2      lv_color_hex(0x101A33)
#define COL_PANEL    lv_color_hex(0x0E1A38)
#define COL_CARD     lv_color_hex(0x1B2545)
#define COL_CARD2    lv_color_hex(0x131C36)
#define COL_LINE     lv_color_hex(0x2C3A60)
#define COL_TXT      lv_color_hex(0xE6EDFF)
#define COL_SUB      lv_color_hex(0x8C9AC0)
#define ACC_GREEN    lv_color_hex(0x2DD4A7)
#define ACC_ORANGE   lv_color_hex(0xF6A43B)
#define ACC_CYAN     lv_color_hex(0x39BDF8)
#define ACC_PINK     lv_color_hex(0xFB7185)
#define ACC_PURPLE   lv_color_hex(0xA78BFA)

/* ---- Driver state (QEMU 后端专用) ---- */
#if CONFIG_AXP202_UI_PANEL_QEMU_RGB
static esp_lcd_panel_handle_t s_panel = NULL;
static lv_display_t          *s_disp  = NULL;
static SemaphoreHandle_t      s_lvgl_mux = NULL;
#endif

/* ---- UI widgets that update over time ---- */
static lv_obj_t *s_time_lbl   = NULL;
static lv_obj_t *s_batt_lbl   = NULL;
static lv_obj_t *s_vbat_lbl   = NULL;
static lv_obj_t *s_ibat_lbl   = NULL;
static lv_obj_t *s_batt_bar   = NULL;
static lv_obj_t *s_temp_lbl   = NULL;
static lv_obj_t *s_acin_lbl   = NULL;
static lv_obj_t *s_vbus_lbl   = NULL;

/* Power-output card + switch dialog */
static lv_obj_t *s_rails_card  = NULL;
static lv_obj_t *s_dlg_bg      = NULL;   /* 开关浮窗遮罩，NULL=未打开 */
static lv_obj_t *s_confirm2_bg = NULL;   /* 关键轨二次确认遮罩，NULL=未打开 */
static lv_obj_t *s_rail_sw[AXP202_RAIL_COUNT];

/* ===================== LVGL <-> QEMU RGB panel glue ===================== */
#if CONFIG_AXP202_UI_PANEL_QEMU_RGB

static void lvgl_flush_cb(lv_display_t *disp, const lv_area_t *area, uint8_t *px_map)
{
    esp_lcd_panel_draw_bitmap(s_panel, area->x1, area->y1,
                              area->x2 + 1, area->y2 + 1, px_map);
    lv_display_flush_ready(disp);
}

static void lvgl_tick_cb(void *arg)
{
    lv_tick_inc(LVGL_TICK_PERIOD_MS);
}

static bool lvgl_lock(int timeout_ms)
{
    const TickType_t ticks = (timeout_ms < 0) ? portMAX_DELAY : pdMS_TO_TICKS(timeout_ms);
    return xSemaphoreTakeRecursive(s_lvgl_mux, ticks) == pdTRUE;
}

static void lvgl_unlock(void)
{
    xSemaphoreGiveRecursive(s_lvgl_mux);
}

static void lvgl_task(void *arg)
{
    ESP_LOGI(TAG, "LVGL task started");
    uint32_t delay_ms = LVGL_TASK_MAX_DELAY_MS;
    while (1) {
        if (lvgl_lock(-1)) {
            delay_ms = lv_timer_handler();
            lvgl_unlock();
        }
        if (delay_ms > LVGL_TASK_MAX_DELAY_MS) {
            delay_ms = LVGL_TASK_MAX_DELAY_MS;
        } else if (delay_ms < LVGL_TASK_MIN_DELAY_MS) {
            delay_ms = LVGL_TASK_MIN_DELAY_MS;
        }
        vTaskDelay(pdMS_TO_TICKS(delay_ms));
    }
}

#endif /* CONFIG_AXP202_UI_PANEL_QEMU_RGB */

/* ===================== UI helpers ===================== */

static lv_obj_t *make_card(lv_obj_t *parent, int x, int y, int w, int h)
{
    lv_obj_t *c = lv_obj_create(parent);
    lv_obj_set_pos(c, x, y);
    lv_obj_set_size(c, w, h);
    lv_obj_remove_flag(c, LV_OBJ_FLAG_SCROLLABLE);
    lv_obj_set_style_radius(c, 10, 0);
    lv_obj_set_style_bg_color(c, COL_CARD, 0);
    lv_obj_set_style_bg_grad_color(c, COL_CARD2, 0);
    lv_obj_set_style_bg_grad_dir(c, LV_GRAD_DIR_VER, 0);
    lv_obj_set_style_border_color(c, COL_LINE, 0);
    lv_obj_set_style_border_width(c, 1, 0);
    lv_obj_set_style_pad_all(c, 8, 0);
    lv_obj_set_style_shadow_width(c, 0, 0);
    return c;
}

static void card_title(lv_obj_t *card, const char *txt, lv_color_t accent)
{
    lv_obj_t *chip = lv_obj_create(card);
    lv_obj_set_size(chip, 4, 13);
    lv_obj_align(chip, LV_ALIGN_TOP_LEFT, 0, 1);
    lv_obj_set_style_radius(chip, 2, 0);
    lv_obj_set_style_bg_color(chip, accent, 0);
    lv_obj_set_style_border_width(chip, 0, 0);
    lv_obj_remove_flag(chip, LV_OBJ_FLAG_SCROLLABLE);

    lv_obj_t *t = lv_label_create(card);
    lv_label_set_text(t, txt);
    lv_obj_set_style_text_color(t, COL_SUB, 0);
    lv_obj_set_style_text_font(t, &font_zh_16, 0);
    lv_obj_align(t, LV_ALIGN_TOP_LEFT, 11, -1);
}

/* A "name .......... value" row inside a card */
static void kv_row(lv_obj_t *card, int y, const char *name,
                   const char *value, lv_color_t value_col)
{
    lv_obj_t *n = lv_label_create(card);
    lv_label_set_text(n, name);
    lv_obj_set_style_text_color(n, COL_TXT, 0);
    lv_obj_set_style_text_font(n, &lv_font_montserrat_14, 0);
    lv_obj_align(n, LV_ALIGN_TOP_LEFT, 2, y);

    lv_obj_t *v = lv_label_create(card);
    lv_label_set_text(v, value);
    lv_obj_set_style_text_color(v, value_col, 0);
    lv_obj_set_style_text_font(v, &lv_font_montserrat_14, 0);
    lv_obj_align(v, LV_ALIGN_TOP_RIGHT, -2, y);
}

/* A power-rail row: shows "<mv> mV" in green when enabled, else "OFF" in grey. */
static void rail_row(lv_obj_t *card, int y, const char *name, int mv, bool on)
{
    char b[24];
    if (on) {
        snprintf(b, sizeof(b), "%d mV", mv);
        kv_row(card, y, name, b, ACC_GREEN);
    } else {
        kv_row(card, y, name, "OFF", COL_SUB);
    }
}

/* ===================== UI data cache ===================== */

typedef struct {
    int   dcdc2_mv, dcdc3_mv, ldo2_mv, ldo3_mv, ldo4_mv;
    bool  dcdc2_on, dcdc3_on, ldo2_on, ldo3_on, ldo4_on;
    bool  exten;
    bool  charging;
    float vbat_v, ibat_ma;      /* ibat_ma: +charge / -discharge */
    int   batt_pct;
    float acin_v, acin_ma;
    float vbus_v, vbus_ma;
    float temp_c;
} axp_data_t;

/* Defaults double as the QEMU simulated values. */
static axp_data_t s_axp = {
    .dcdc2_mv = 1550, .dcdc3_mv = 3300,
    .ldo2_mv = 3000, .ldo3_mv = 2500, .ldo4_mv = 3300,
    .dcdc2_on = true, .dcdc3_on = true,
    .ldo2_on = true, .ldo3_on = true, .ldo4_on = true,
    .exten = true,
    .charging = true,
    .vbat_v = 3.80f, .ibat_ma = 132.0f, .batt_pct = 93,
    .acin_v = 4.54f, .acin_ma = 81.25f,
    .vbus_v = 4.38f, .vbus_ma = 155.62f,
    .temp_c = 32.8f,
};

/* ===================== Power-rail card + switch dialog ===================== */

static void rails_fill(lv_obj_t *card);
static void rails_reload(void);
static void power_dialog_open(void);
#if !CONFIG_AXP202_UI_PANEL_QEMU_RGB
static void axp_pull_live(void);
#endif

/* Fill the (cleared) power-output card: title + 5 rails + EXTEN + edit hint. */
static void rails_fill(lv_obj_t *card)
{
    card_title(card, "电源输出", ACC_GREEN);
    rail_row(card, 24,  "DCDC2", s_axp.dcdc2_mv, s_axp.dcdc2_on);
    rail_row(card, 52,  "DCDC3", s_axp.dcdc3_mv, s_axp.dcdc3_on);
    rail_row(card, 80,  "LDO2",  s_axp.ldo2_mv,  s_axp.ldo2_on);
    rail_row(card, 108, "LDO3",  s_axp.ldo3_mv,  s_axp.ldo3_on);
    rail_row(card, 136, "LDO4",  s_axp.ldo4_mv,  s_axp.ldo4_on);
    kv_row(card, 164, "EXTEN", s_axp.exten ? LV_SYMBOL_OK " ON" : "OFF",
           s_axp.exten ? ACC_GREEN : COL_SUB);

    /* “可点击编辑”提示图标（右上角）*/
    lv_obj_t *hint = lv_label_create(card);
    lv_label_set_text(hint, LV_SYMBOL_EDIT);
    lv_obj_set_style_text_color(hint, ACC_CYAN, 0);
    lv_obj_set_style_text_font(hint, &lv_font_montserrat_14, 0);
    lv_obj_align(hint, LV_ALIGN_TOP_RIGHT, 2, -1);
}

static void rails_reload(void)
{
    if (!s_rails_card) {
        return;
    }
    lv_obj_clean(s_rails_card);
    rails_fill(s_rails_card);
}

/* Apply one rail on/off: drive real AXP202 on hardware, always update UI cache. */
static void power_apply_rail(int idx, bool on)
{
#if !CONFIG_AXP202_UI_PANEL_QEMU_RGB
    axp202_set_rail((axp202_rail_t)idx, on);
#endif
    switch (idx) {
    case AXP202_RAIL_DCDC2: s_axp.dcdc2_on = on; break;
    case AXP202_RAIL_DCDC3: s_axp.dcdc3_on = on; break;
    case AXP202_RAIL_LDO2:  s_axp.ldo2_on  = on; break;
    case AXP202_RAIL_LDO3:  s_axp.ldo3_on  = on; break;
    case AXP202_RAIL_LDO4:  s_axp.ldo4_on  = on; break;
    case AXP202_RAIL_EXTEN: s_axp.exten    = on; break;
    default: break;
    }
}

static void power_dialog_close(void)
{
    if (s_dlg_bg) {
        lv_obj_del(s_dlg_bg);
        s_dlg_bg = NULL;
    }
}

/* 关键电源轨：关闭会断电/黑屏（DCDC3=主控供电，LDO2=屏幕与SD卡供电）*/
static bool rail_is_critical(int idx)
{
    return idx == AXP202_RAIL_DCDC3 || idx == AXP202_RAIL_LDO2;
}

/* 该轨当前（UI 缓存中的）使能状态 */
static bool rail_current_on(int idx)
{
    switch (idx) {
    case AXP202_RAIL_DCDC2: return s_axp.dcdc2_on;
    case AXP202_RAIL_DCDC3: return s_axp.dcdc3_on;
    case AXP202_RAIL_LDO2:  return s_axp.ldo2_on;
    case AXP202_RAIL_LDO3:  return s_axp.ldo3_on;
    case AXP202_RAIL_LDO4:  return s_axp.ldo4_on;
    case AXP202_RAIL_EXTEN: return s_axp.exten;
    default: return false;
    }
}

/* 真正应用开关面板：逐路落地 + 刷新主卡片 + 关开关浮窗 */
static void power_commit(void)
{
    for (int i = 0; i < AXP202_RAIL_COUNT; i++) {
        bool on = lv_obj_has_state(s_rail_sw[i], LV_STATE_CHECKED);
        power_apply_rail(i, on);
    }
#if !CONFIG_AXP202_UI_PANEL_QEMU_RGB
    axp_pull_live();   /* 回读硬件真实状态 */
#endif
    rails_reload();
    power_dialog_close();
}

static void power_confirm2_close(void)
{
    if (s_confirm2_bg) {
        lv_obj_del(s_confirm2_bg);
        s_confirm2_bg = NULL;
    }
}

/* 二次确认——返回：不生效，回到开关浮窗 */
static void confirm2_back_cb(lv_event_t *e)
{
    (void)e;
    power_confirm2_close();
}

/* 二次确认——仍要关闭：生效并关闭两层浮窗 */
static void confirm2_accept_cb(lv_event_t *e)
{
    (void)e;
    power_confirm2_close();
    power_commit();
}

/* 关键轨即将被关闭时弹出的警告确认框（叠在开关浮窗之上）*/
static void power_confirm2_open(void)
{
    if (s_confirm2_bg) {
        return;
    }

    s_confirm2_bg = lv_obj_create(lv_layer_top());
    lv_obj_remove_style_all(s_confirm2_bg);
    lv_obj_set_size(s_confirm2_bg, LV_PCT(100), LV_PCT(100));
    lv_obj_set_style_bg_color(s_confirm2_bg, lv_color_black(), 0);
    lv_obj_set_style_bg_opa(s_confirm2_bg, LV_OPA_70, 0);
    lv_obj_add_flag(s_confirm2_bg, LV_OBJ_FLAG_CLICKABLE);
    lv_obj_remove_flag(s_confirm2_bg, LV_OBJ_FLAG_SCROLLABLE);

    lv_obj_t *box = lv_obj_create(s_confirm2_bg);
    lv_obj_set_size(box, 290, 150);
    lv_obj_center(box);
    lv_obj_set_style_radius(box, 12, 0);
    lv_obj_set_style_bg_color(box, COL_CARD, 0);
    lv_obj_set_style_bg_grad_color(box, COL_CARD2, 0);
    lv_obj_set_style_bg_grad_dir(box, LV_GRAD_DIR_VER, 0);
    lv_obj_set_style_border_color(box, ACC_PINK, 0);
    lv_obj_set_style_border_width(box, 2, 0);
    lv_obj_set_style_pad_all(box, 10, 0);
    lv_obj_set_style_pad_row(box, 4, 0);
    lv_obj_set_flex_flow(box, LV_FLEX_FLOW_COLUMN);
    lv_obj_remove_flag(box, LV_OBJ_FLAG_SCROLLABLE);

    lv_obj_t *title = lv_label_create(box);
    lv_label_set_text(title, "危险操作");
    lv_obj_set_style_text_color(title, ACC_PINK, 0);
    lv_obj_set_style_text_font(title, &font_zh_16, 0);

    lv_obj_t *msg = lv_label_create(box);
    lv_label_set_text(msg, "关闭主控或屏幕供电\n可能断电或黑屏");
    lv_obj_set_style_text_color(msg, COL_TXT, 0);
    lv_obj_set_style_text_font(msg, &font_zh_16, 0);

    lv_obj_t *btns = lv_obj_create(box);
    lv_obj_remove_style_all(btns);
    lv_obj_set_size(btns, LV_PCT(100), 34);
    lv_obj_set_style_pad_top(btns, 4, 0);
    lv_obj_set_flex_flow(btns, LV_FLEX_FLOW_ROW);
    lv_obj_set_flex_align(btns, LV_FLEX_ALIGN_SPACE_EVENLY,
                          LV_FLEX_ALIGN_CENTER, LV_FLEX_ALIGN_CENTER);
    lv_obj_remove_flag(btns, LV_OBJ_FLAG_SCROLLABLE);

    lv_obj_t *back = lv_button_create(btns);
    lv_obj_set_size(back, 118, 30);
    lv_obj_set_style_bg_color(back, COL_CARD, 0);
    lv_obj_set_style_radius(back, 8, 0);
    lv_obj_add_event_cb(back, confirm2_back_cb, LV_EVENT_CLICKED, NULL);
    lv_obj_t *bl = lv_label_create(back);
    lv_label_set_text(bl, "返回");
    lv_obj_set_style_text_color(bl, COL_TXT, 0);
    lv_obj_set_style_text_font(bl, &font_zh_16, 0);
    lv_obj_center(bl);

    lv_obj_t *go = lv_button_create(btns);
    lv_obj_set_size(go, 118, 30);
    lv_obj_set_style_bg_color(go, ACC_PINK, 0);
    lv_obj_set_style_radius(go, 8, 0);
    lv_obj_add_event_cb(go, confirm2_accept_cb, LV_EVENT_CLICKED, NULL);
    lv_obj_t *gl = lv_label_create(go);
    lv_label_set_text(gl, "仍要关闭");
    lv_obj_set_style_text_color(gl, lv_color_black(), 0);
    lv_obj_set_style_text_font(gl, &font_zh_16, 0);
    lv_obj_center(gl);
}

static void dlg_cancel_cb(lv_event_t *e)
{
    (void)e;
    power_dialog_close();
}

/* 确认：若本次会关闭正在供电的关键轨(DCDC3/LDO2)，先弹二次确认；否则直接生效 */
static void dlg_confirm_cb(lv_event_t *e)
{
    (void)e;
    bool danger = false;
    for (int i = 0; i < AXP202_RAIL_COUNT; i++) {
        bool want = lv_obj_has_state(s_rail_sw[i], LV_STATE_CHECKED);
        if (rail_is_critical(i) && rail_current_on(i) && !want) {
            danger = true;   /* 正在供电的关键轨即将被关闭 */
            break;
        }
    }

    if (danger) {
        power_confirm2_open();   /* 二次确认，用户点“仍要关闭”后才 power_commit */
    } else {
        power_commit();
    }
}

/* Modal dialog: one lv_switch per rail + 取消/确认按钮 */
static void power_dialog_open(void)
{
    if (s_dlg_bg) {
        return;   /* already open */
    }

    /* 半透明模态遮罩（置于顶层，吞掉背景点击）*/
    s_dlg_bg = lv_obj_create(lv_layer_top());
    lv_obj_remove_style_all(s_dlg_bg);
    lv_obj_set_size(s_dlg_bg, LV_PCT(100), LV_PCT(100));
    lv_obj_set_style_bg_color(s_dlg_bg, lv_color_black(), 0);
    lv_obj_set_style_bg_opa(s_dlg_bg, LV_OPA_60, 0);
    lv_obj_add_flag(s_dlg_bg, LV_OBJ_FLAG_CLICKABLE);
    lv_obj_remove_flag(s_dlg_bg, LV_OBJ_FLAG_SCROLLABLE);

    /* 对话框卡片 */
    lv_obj_t *dlg = lv_obj_create(s_dlg_bg);
    lv_obj_set_size(dlg, 296, 230);
    lv_obj_center(dlg);
    lv_obj_set_style_radius(dlg, 12, 0);
    lv_obj_set_style_bg_color(dlg, COL_PANEL, 0);
    lv_obj_set_style_bg_grad_color(dlg, COL_CARD2, 0);
    lv_obj_set_style_bg_grad_dir(dlg, LV_GRAD_DIR_VER, 0);
    lv_obj_set_style_border_color(dlg, COL_LINE, 0);
    lv_obj_set_style_border_width(dlg, 1, 0);
    lv_obj_set_style_pad_all(dlg, 8, 0);
    lv_obj_set_style_pad_row(dlg, 2, 0);
    lv_obj_set_flex_flow(dlg, LV_FLEX_FLOW_COLUMN);
    lv_obj_remove_flag(dlg, LV_OBJ_FLAG_SCROLLABLE);

    lv_obj_t *title = lv_label_create(dlg);
    lv_label_set_text(title, "电源输出控制");
    lv_obj_set_style_text_color(title, COL_TXT, 0);
    lv_obj_set_style_text_font(title, &font_zh_16, 0);

    const char *names[AXP202_RAIL_COUNT] = {"DCDC2", "DCDC3", "LDO2", "LDO3", "LDO4", "EXTEN"};
    const bool init_on[AXP202_RAIL_COUNT] = {
        s_axp.dcdc2_on, s_axp.dcdc3_on, s_axp.ldo2_on,
        s_axp.ldo3_on, s_axp.ldo4_on, s_axp.exten,
    };

    for (int i = 0; i < AXP202_RAIL_COUNT; i++) {
        lv_obj_t *row = lv_obj_create(dlg);
        lv_obj_remove_style_all(row);
        lv_obj_set_size(row, LV_PCT(100), 23);
        lv_obj_set_flex_flow(row, LV_FLEX_FLOW_ROW);
        lv_obj_set_flex_align(row, LV_FLEX_ALIGN_SPACE_BETWEEN,
                              LV_FLEX_ALIGN_CENTER, LV_FLEX_ALIGN_CENTER);
        lv_obj_remove_flag(row, LV_OBJ_FLAG_SCROLLABLE);

        lv_obj_t *nl = lv_label_create(row);
        lv_label_set_text(nl, names[i]);
        lv_obj_set_style_text_color(nl, COL_TXT, 0);
        lv_obj_set_style_text_font(nl, &lv_font_montserrat_14, 0);

        lv_obj_t *sw = lv_switch_create(row);
        lv_obj_set_size(sw, 46, 22);
        lv_obj_set_style_bg_color(sw, ACC_GREEN, LV_PART_INDICATOR | LV_STATE_CHECKED);
        if (init_on[i]) {
            lv_obj_add_state(sw, LV_STATE_CHECKED);
        }
        s_rail_sw[i] = sw;
    }

    /* 底部按钮：取消 / 确认 */
    lv_obj_t *btns = lv_obj_create(dlg);
    lv_obj_remove_style_all(btns);
    lv_obj_set_size(btns, LV_PCT(100), 34);
    lv_obj_set_style_pad_top(btns, 2, 0);
    lv_obj_set_flex_flow(btns, LV_FLEX_FLOW_ROW);
    lv_obj_set_flex_align(btns, LV_FLEX_ALIGN_SPACE_EVENLY,
                          LV_FLEX_ALIGN_CENTER, LV_FLEX_ALIGN_CENTER);
    lv_obj_remove_flag(btns, LV_OBJ_FLAG_SCROLLABLE);

    lv_obj_t *cancel = lv_button_create(btns);
    lv_obj_set_size(cancel, 122, 30);
    lv_obj_set_style_bg_color(cancel, COL_CARD, 0);
    lv_obj_set_style_radius(cancel, 8, 0);
    lv_obj_add_event_cb(cancel, dlg_cancel_cb, LV_EVENT_CLICKED, NULL);
    lv_obj_t *cl = lv_label_create(cancel);
    lv_label_set_text(cl, "取消");
    lv_obj_set_style_text_color(cl, COL_TXT, 0);
    lv_obj_set_style_text_font(cl, &font_zh_16, 0);
    lv_obj_center(cl);

    lv_obj_t *ok = lv_button_create(btns);
    lv_obj_set_size(ok, 122, 30);
    lv_obj_set_style_bg_color(ok, ACC_GREEN, 0);
    lv_obj_set_style_radius(ok, 8, 0);
    lv_obj_add_event_cb(ok, dlg_confirm_cb, LV_EVENT_CLICKED, NULL);
    lv_obj_t *ol = lv_label_create(ok);
    lv_label_set_text(ol, "确认");
    lv_obj_set_style_text_color(ol, lv_color_black(), 0);
    lv_obj_set_style_text_font(ol, &font_zh_16, 0);
    lv_obj_center(ol);
}

static void rails_click_cb(lv_event_t *e)
{
    (void)e;
    power_dialog_open();
}

#if CONFIG_AXP202_UI_PANEL_QEMU_RGB
/* QEMU 无触摸输入：用一个多步定时器脚本化演示“弹窗→改开关→确认→刷新”整套交互，
 * 便于截图/录像。真机则由手指触摸驱动同一套逻辑。 */
static void demo_seq_cb(lv_timer_t *t)
{
    (void)t;
    static int step = 0;
    static bool want = true;    /* 每轮翻转 LDO2（关键轨）目标状态 */
    switch (step) {
    case 0:
        power_dialog_open();                 /* 打开开关浮窗 */
        break;
    case 1:
        if (s_dlg_bg) {                      /* 模拟用户拨动 LDO2（关键轨）*/
            want = !want;
            if (want) {
                lv_obj_add_state(s_rail_sw[AXP202_RAIL_LDO2], LV_STATE_CHECKED);
            } else {
                lv_obj_remove_state(s_rail_sw[AXP202_RAIL_LDO2], LV_STATE_CHECKED);
            }
        }
        break;
    case 2:
        dlg_confirm_cb(NULL);                /* 关 LDO2→弹二次确认；开 LDO2→直接生效 */
        break;
    case 3:
        if (s_confirm2_bg) {                 /* 若弹出二次确认，点“仍要关闭” */
            confirm2_accept_cb(NULL);
        }
        break;
    default:
        break;
    }
    step = (step + 1) % 4;                    /* 循环演示，便于录像 */
}
#endif

/* ===================== Build the dashboard ===================== */

static void axp202_ui_create(void)
{
    lv_obj_t *scr = lv_screen_active();
    lv_obj_set_style_bg_color(scr, COL_BG, 0);
    lv_obj_set_style_bg_grad_color(scr, COL_BG2, 0);
    lv_obj_set_style_bg_grad_dir(scr, LV_GRAD_DIR_VER, 0);
    lv_obj_remove_flag(scr, LV_OBJ_FLAG_SCROLLABLE);
    lv_obj_set_style_pad_all(scr, 0, 0);

    /* ---------- Top status bar ---------- */
    lv_obj_t *bar = lv_obj_create(scr);
    lv_obj_set_size(bar, LCD_H_RES, 26);
    lv_obj_set_pos(bar, 0, 0);
    lv_obj_remove_flag(bar, LV_OBJ_FLAG_SCROLLABLE);
    lv_obj_set_style_radius(bar, 0, 0);
    lv_obj_set_style_bg_color(bar, COL_PANEL, 0);
    lv_obj_set_style_border_width(bar, 0, 0);
    lv_obj_set_style_pad_all(bar, 0, 0);

    s_time_lbl = lv_label_create(bar);
    lv_label_set_text(s_time_lbl, "--:--:--");
    lv_obj_set_style_text_color(s_time_lbl, COL_TXT, 0);
    lv_obj_set_style_text_font(s_time_lbl, &lv_font_montserrat_14, 0);
    lv_obj_align(s_time_lbl, LV_ALIGN_LEFT_MID, 10, 0);

    lv_obj_t *brand = lv_label_create(bar);
    lv_label_set_text(brand, "电源监视器");
    lv_obj_set_style_text_color(brand, ACC_CYAN, 0);
    lv_obj_set_style_text_font(brand, &font_zh_16, 0);
    lv_obj_align(brand, LV_ALIGN_CENTER, 0, 0);

    s_batt_lbl = lv_label_create(bar);
    lv_label_set_text_fmt(s_batt_lbl, "%d%% %s%s", s_axp.batt_pct,
                          s_axp.charging ? LV_SYMBOL_CHARGE : "", LV_SYMBOL_BATTERY_FULL);
    lv_obj_set_style_text_color(s_batt_lbl, ACC_GREEN, 0);
    lv_obj_set_style_text_font(s_batt_lbl, &lv_font_montserrat_14, 0);
    lv_obj_align(s_batt_lbl, LV_ALIGN_RIGHT_MID, -8, 0);

    /* ---------- Left column: system rails (触摸打开开关浮窗) ---------- */
    s_rails_card = make_card(scr, 6, 30, 150, 204);
    lv_obj_add_flag(s_rails_card, LV_OBJ_FLAG_CLICKABLE);
    lv_obj_add_event_cb(s_rails_card, rails_click_cb, LV_EVENT_CLICKED, NULL);
    rails_fill(s_rails_card);

    /* ---------- Right column top: battery ---------- */
    lv_obj_t *batt = make_card(scr, 162, 30, 152, 96);
    card_title(batt, "电池状态", ACC_CYAN);

    char buf[48];
    s_vbat_lbl = lv_label_create(batt);
    snprintf(buf, sizeof(buf), "%.2f V", s_axp.vbat_v);
    lv_label_set_text(s_vbat_lbl, buf);
    lv_obj_set_style_text_color(s_vbat_lbl, COL_TXT, 0);
    lv_obj_set_style_text_font(s_vbat_lbl, &lv_font_montserrat_28, 0);
    lv_obj_align(s_vbat_lbl, LV_ALIGN_TOP_LEFT, 2, 22);

    s_ibat_lbl = lv_label_create(batt);
    if (s_axp.charging) {
        snprintf(buf, sizeof(buf), LV_SYMBOL_CHARGE " charging  %.0f mA", s_axp.ibat_ma);
    } else {
        snprintf(buf, sizeof(buf), "discharge  %.0f mA", -s_axp.ibat_ma);
    }
    lv_label_set_text(s_ibat_lbl, buf);
    lv_obj_set_style_text_color(s_ibat_lbl, ACC_ORANGE, 0);
    lv_obj_set_style_text_font(s_ibat_lbl, &lv_font_montserrat_12, 0);
    lv_obj_align(s_ibat_lbl, LV_ALIGN_TOP_LEFT, 2, 52);

    s_batt_bar = lv_bar_create(batt);
    lv_obj_set_size(s_batt_bar, 132, 8);
    lv_obj_align(s_batt_bar, LV_ALIGN_TOP_LEFT, 2, 70);
    lv_obj_set_style_bg_color(s_batt_bar, COL_CARD2, LV_PART_MAIN);
    lv_obj_set_style_border_width(s_batt_bar, 1, LV_PART_MAIN);
    lv_obj_set_style_border_color(s_batt_bar, COL_LINE, LV_PART_MAIN);
    lv_obj_set_style_bg_color(s_batt_bar, ACC_GREEN, LV_PART_INDICATOR);
    lv_obj_set_style_radius(s_batt_bar, 4, LV_PART_MAIN);
    lv_obj_set_style_radius(s_batt_bar, 4, LV_PART_INDICATOR);
    lv_bar_set_range(s_batt_bar, 0, 100);
    lv_bar_set_value(s_batt_bar, s_axp.batt_pct, LV_ANIM_OFF);

    /* ---------- Right column middle: input power ---------- */
    lv_obj_t *in = make_card(scr, 162, 130, 152, 60);
    card_title(in, "输入电源", ACC_PURPLE);
    s_acin_lbl = lv_label_create(in);
    snprintf(buf, sizeof(buf), "ACIN   %.2f V   %.0f mA", s_axp.acin_v, s_axp.acin_ma);
    lv_label_set_text(s_acin_lbl, buf);
    lv_obj_set_style_text_color(s_acin_lbl, COL_TXT, 0);
    lv_obj_set_style_text_font(s_acin_lbl, &lv_font_montserrat_12, 0);
    lv_obj_align(s_acin_lbl, LV_ALIGN_TOP_LEFT, 2, 22);
    s_vbus_lbl = lv_label_create(in);
    snprintf(buf, sizeof(buf), "VBUS   %.2f V   %.0f mA", s_axp.vbus_v, s_axp.vbus_ma);
    lv_label_set_text(s_vbus_lbl, buf);
    lv_obj_set_style_text_color(s_vbus_lbl, COL_TXT, 0);
    lv_obj_set_style_text_font(s_vbus_lbl, &lv_font_montserrat_12, 0);
    lv_obj_align(s_vbus_lbl, LV_ALIGN_TOP_LEFT, 2, 40);

    /* ---------- Right column bottom: temperature ---------- */
    lv_obj_t *temp = make_card(scr, 162, 194, 152, 40);
    card_title(temp, "芯片温度", ACC_PINK);
    s_temp_lbl = lv_label_create(temp);
    snprintf(buf, sizeof(buf), "%.1f C", s_axp.temp_c);
    lv_label_set_text(s_temp_lbl, buf);
    lv_obj_set_style_text_color(s_temp_lbl, ACC_PINK, 0);
    lv_obj_set_style_text_font(s_temp_lbl, &lv_font_montserrat_20, 0);
    lv_obj_align(s_temp_lbl, LV_ALIGN_TOP_RIGHT, -2, 6);
}

/* ===================== Refresh the dynamic widgets from s_axp ===================== */

static void ui_refresh_dynamic(void)
{
    char b[48];

    int pct = s_axp.batt_pct < 0 ? 0 : s_axp.batt_pct;
    lv_label_set_text_fmt(s_batt_lbl, "%d%% %s%s", pct,
                          s_axp.charging ? LV_SYMBOL_CHARGE : "", LV_SYMBOL_BATTERY_FULL);

    snprintf(b, sizeof(b), "%.2f V", s_axp.vbat_v);
    lv_label_set_text(s_vbat_lbl, b);

    if (s_axp.charging) {
        snprintf(b, sizeof(b), LV_SYMBOL_CHARGE " charging  %.0f mA", s_axp.ibat_ma);
    } else {
        snprintf(b, sizeof(b), "discharge  %.0f mA", -s_axp.ibat_ma);
    }
    lv_label_set_text(s_ibat_lbl, b);

    lv_bar_set_value(s_batt_bar, pct, LV_ANIM_OFF);

    snprintf(b, sizeof(b), "ACIN   %.2f V   %.0f mA", s_axp.acin_v, s_axp.acin_ma);
    lv_label_set_text(s_acin_lbl, b);
    snprintf(b, sizeof(b), "VBUS   %.2f V   %.0f mA", s_axp.vbus_v, s_axp.vbus_ma);
    lv_label_set_text(s_vbus_lbl, b);

    snprintf(b, sizeof(b), "%.1f C", s_axp.temp_c);
    lv_label_set_text(s_temp_lbl, b);
}

#if !CONFIG_AXP202_UI_PANEL_QEMU_RGB
/* Pull one live snapshot from the real AXP202 into the UI cache. */
static void axp_pull_live(void)
{
    axp202_dashboard_t d;
    if (axp202_read_dashboard(&d) != ESP_OK) {
        return;
    }
    s_axp.dcdc2_mv = d.dcdc2_mv;  s_axp.dcdc2_on = d.dcdc2_on;
    s_axp.dcdc3_mv = d.dcdc3_mv;  s_axp.dcdc3_on = d.dcdc3_on;
    s_axp.ldo2_mv  = d.ldo2_mv;   s_axp.ldo2_on  = d.ldo2_on;
    s_axp.ldo3_mv  = d.ldo3_mv;   s_axp.ldo3_on  = d.ldo3_on;
    s_axp.ldo4_mv  = d.ldo4_mv;   s_axp.ldo4_on  = d.ldo4_on;
    s_axp.exten    = d.exten_on;

    s_axp.charging = d.charging;
    s_axp.vbat_v   = d.vbat_v;
    s_axp.batt_pct = d.batt_pct;
    s_axp.ibat_ma  = d.ibat_ma;

    s_axp.acin_v  = d.acin_v;  s_axp.acin_ma = d.acin_ma;
    s_axp.vbus_v  = d.vbus_v;  s_axp.vbus_ma = d.vbus_ma;
    s_axp.temp_c  = d.temp_c;
}
#endif

/* ===================== Periodic data update ===================== */

static void data_timer_cb(lv_timer_t *t)
{
#if CONFIG_AXP202_UI_PANEL_QEMU_RGB
    /* QEMU：无真实 PMU，模拟一个“活着”的仪表盘 */
    static int sec = 45, mn = 42, hr = 15;
    if (++sec >= 60) { sec = 0; if (++mn >= 60) { mn = 0; hr = (hr + 1) % 24; } }
    lv_label_set_text_fmt(s_time_lbl, "%02d:%02d:%02d", hr, mn, sec);

    s_axp.ibat_ma = 132.0f + (float)((int)lv_rand(0, 160) - 80) / 10.0f;
    s_axp.vbat_v  = 3.80f + (float)lv_rand(0, 6) / 100.0f;
    s_axp.temp_c  = 32.8f + (float)((int)lv_rand(0, 20) - 10) / 10.0f;
    ui_refresh_dynamic();
#else
    /* 真机：读取 RTC 时间与 AXP202 实时数据 */
    update_RTC_global_variable();
    char hms[16] = {0};
    if (sscanf(RTC_global_variable, "%*s %15s", hms) == 1) {
        lv_label_set_text(s_time_lbl, hms);
    } else {
        lv_label_set_text(s_time_lbl, RTC_global_variable);
    }

    axp_pull_live();
    ui_refresh_dynamic();
#endif
}

/* ===================== app_main ===================== */

#if CONFIG_AXP202_UI_PANEL_QEMU_RGB

void app_main(void)
{
    ESP_LOGI(TAG, "Install QEMU virtual RGB panel (%dx%d)", LCD_H_RES, LCD_V_RES);
    const esp_lcd_rgb_qemu_config_t panel_cfg = {
        .width  = LCD_H_RES,
        .height = LCD_V_RES,
        .bpp    = RGB_QEMU_BPP_16,
    };
    ESP_ERROR_CHECK(esp_lcd_new_rgb_qemu(&panel_cfg, &s_panel));
    ESP_ERROR_CHECK(esp_lcd_panel_reset(s_panel));
    ESP_ERROR_CHECK(esp_lcd_panel_init(s_panel));

    ESP_LOGI(TAG, "Initialize LVGL");
    lv_init();

    s_disp = lv_display_create(LCD_H_RES, LCD_V_RES);
    lv_display_set_color_format(s_disp, LV_COLOR_FORMAT_RGB565);
    lv_display_set_flush_cb(s_disp, lvgl_flush_cb);

    static uint8_t buf1[LCD_H_RES * LVGL_BUF_LINES * 2];
    static uint8_t buf2[LCD_H_RES * LVGL_BUF_LINES * 2];
    lv_display_set_buffers(s_disp, buf1, buf2, sizeof(buf1), LV_DISPLAY_RENDER_MODE_PARTIAL);

    const esp_timer_create_args_t tick_args = {
        .callback = &lvgl_tick_cb,
        .name = "lvgl_tick",
    };
    esp_timer_handle_t tick_timer = NULL;
    ESP_ERROR_CHECK(esp_timer_create(&tick_args, &tick_timer));
    ESP_ERROR_CHECK(esp_timer_start_periodic(tick_timer, LVGL_TICK_PERIOD_MS * 1000));

    s_lvgl_mux = xSemaphoreCreateRecursiveMutex();
    assert(s_lvgl_mux);
    xTaskCreate(lvgl_task, "LVGL", LVGL_TASK_STACK, NULL, LVGL_TASK_PRIORITY, NULL);

    ESP_LOGI(TAG, "Build AXP202 dashboard (QEMU RGB, simulated data)");
    if (lvgl_lock(-1)) {
        axp202_ui_create();
        lv_timer_create(data_timer_cb, 1000, NULL);
        /* QEMU 无触摸输入，用脚本化定时器演示浮窗交互（弹窗→改开关→确认）*/
        lv_timer_create(demo_seq_cb, 2000, NULL);
        lvgl_unlock();
    }
    ESP_LOGI(TAG, "AXP202 dashboard is running");
}

#else /* CONFIG_AXP202_UI_PANEL_ST7789 */

void app_main(void)
{
    /* ---- I2C + 传感器（真实 AXP202 / BM8563）---- */
#if CONFIG_I2C_COMMUNICATION_METHOD_CALLBACK_RW || \
    ((ESP_IDF_VERSION >= ESP_IDF_VERSION_VAL(5, 0, 0)) && \
     (defined(CONFIG_XPOWERS_ESP_IDF_NEW_API) || defined(CONFIG_SENSORLIB_ESP_IDF_NEW_API)))
#if defined(CONFIG_SENSORLIB_ESP_IDF_NEW_API)
    ESP_ERROR_CHECK(i2c_drv_init());
#elif defined(CONFIG_XPOWERS_ESP_IDF_NEW_API)
    ESP_ERROR_CHECK(i2c_init());
#endif
#endif
    ESP_LOGI(TAG, "I2C initialized");

    ESP_ERROR_CHECK(axp202_init());
    ESP_ERROR_CHECK(bm8563_init());

    /* ---- ST7789 LCD + GT911 触摸 + LVGL 移植层 ---- */
    ESP_ERROR_CHECK(app_lcd_init());
    ESP_ERROR_CHECK(app_touch_init());
    ESP_ERROR_CHECK(app_lvgl_init());

    ESP_LOGI(TAG, "Build AXP202 dashboard (ST7789, live data)");
    if (lvgl_port_lock(0)) {
        /* 物理屏 240x320（竖屏），UI 采用 320x240 横屏，旋转 90° 适配 */
        lv_display_t *disp = lv_display_get_default();
        if (disp) {
            lv_display_set_rotation(disp, LV_DISPLAY_ROTATION_90);
        }
        axp_pull_live();      /* 首屏即显示真实数据 */
        axp202_ui_create();
        lv_timer_create(data_timer_cb, 1000, NULL);
        lvgl_port_unlock();
    }
    ESP_LOGI(TAG, "AXP202 dashboard is running");
}

#endif
